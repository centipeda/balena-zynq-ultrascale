## build/conf/bblayers.conf
```bitbake
POKY_BBLAYERS_CONF_VERSION = "1"

BBPATH = "${TOPDIR}"
BBFILES ?= ""

BBLAYERS ?= " \
	${TOPDIR}/../layers/poky/meta \
	${TOPDIR}/../layers/poky/meta-poky \
	${TOPDIR}/../layers/oe-meta-go \
	${TOPDIR}/../layers/meta-openembedded/meta-oe \
	${TOPDIR}/../layers/meta-openembedded/meta-filesystems \
	${TOPDIR}/../layers/meta-openembedded/meta-networking \
	${TOPDIR}/../layers/meta-openembedded/meta-python \
	${TOPDIR}/../layers/meta-xilinx/meta-xilinx-bsp \
	${TOPDIR}/../layers/meta-balena/meta-balena-common \
	${TOPDIR}/../layers/meta-balena/meta-balena-warrior \
	${TOPDIR}/../layers/meta-balena-zx2 \
	${TOPDIR}/../layers/meta-rust \
	"
```

## build/conf/local.conf
```bitbake
# Supported machines
MACHINE ?= "zynq-generic zx2-pm3-zynq7"

DISTRO_FEATURES_append = "systemd virtualization"
DISTRO ?= "resin-systemd"

IMAGE_INSTALL_append = " xilinx-bootbin"

# Barys: Additional variables
```

## layers/meta-balena-zx2/conf/layer.conf
```bitbake
# needs to point to the build directory. "analogous to $PATH"
BBPATH .= ":${LAYERDIR}"

# list of recipe files
BBFILES += "${LAYERDIR}/recipes-*/*/*.bb \
            ${LAYERDIR}/recipes-*/*/*.bbappend"

# list names of configured layers
BBFILE_COLLECTIONS += "zynq-generic"

# expands to match files from BBFILES in a particular layer
BBFILE_PATTERN_zynq-generic := "^${LAYERDIR}/"

# maxes precedence for our layer
BBFILE_PRIORITY_zynq-generic = "1337"

# compatible yocto versions
LAYERSERIES_COMPAT_skeleton = "warrior"
LAYERSERIES_COMPAT_zynq-generic = "warrior"

# extra distro features
DISTRO_FEATURES_append = "systemd virtualization"

# add docker to hosttools
HOSTTOOLS += "/usr/bin/docker"
```

## layers/meta-marspm3-bsp/conf/bblayers.conf
```bitbake
# LAYER_CONF_VERSION is increased each time build/conf/bblayers.conf
# changes incompatibly
LCONF_VERSION = "6"

BBPATH = "${TOPDIR}"
BBFILES ?= ""

BBLAYERS ?= "
    ${TOPDIR}/../layers/meta-xilinx/meta-xilinx-bsp \
    "
    
```

## layers/meta-marspm3-bsp/conf/layer.conf
```bitbake
# We have a conf and classes directory, add to BBPATH
BBPATH .= ":${LAYERDIR}"

# We have recipes-* directories, add to BBFILES
BBFILES += "${LAYERDIR}/recipes-*/*/*.bb \
            ${LAYERDIR}/recipes-*/*/*.bbappend"

BBFILE_COLLECTIONS += "meta-marspm3-bsp"
BBFILE_PATTERN_meta-marspm3-bsp = "^${LAYERDIR}/"
BBFILE_PRIORITY_meta-marspm3-bsp = "6"

LAYERDEPENDS_meta-marspm3-bsp = "core"
LAYERSERIES_COMPAT_meta-marspm3-bsp = "warrior"
```

## layers/meta-marspm3-bsp/conf/machine/marspm3-zynq7.conf
```bitbake
#@TYPE: Machine
#@NAME: marspm3-zynq7
#@DESCRIPTION: Machine configuration for Enclustra PM3 evaluation board with Zynq-7000 SoC
#@HOMEPAGE = "https://www.enclustra.com"

SOC_VARIANT ?= "7z"
SOC_FAMILY ?= "zynq"


require conf/machine/include/tune-zynq.inc
require conf/machine/include/machine-xilinx-default.inc
# require conf/machine/include/machine-xilinx-overrides.inc
# 
# # use this u-boot config because it's the closest to the Mars
UBOOT_MACHINE = "zynq_mars_zx2_defconfig"
# SPL_BINARY ?= "spl/boot.bin"
# SERIAL_CONSOLE = "115200 ttyPS0"
# MACHINE_EXTRA_RRECOMMENDS += " kernel-modules"
# 
# MACHINE_DEVICETREE = " \
#                   mars-pm3.dts \
#                    "
# # KERNEL_DEVICETREE = "mars-pm3.dtb"

EXTRA_IMAGEDEPENDS += " \
                        virtual/bootloader \
                        virtual/boot-bin \
                        "
                        
                        
PREFERRED_PROVIDER_virtual/kernel ?= "linux-xlnx"
PREFERRED_PROVIDER_virtual/bootloader ?= "u-boot-enclustra"
PREFERRED_PROVIDER_virtual/boot-bin ?= "xilinx-bootbin"

MACHINE_FEATURES = "rtc ext2 ext3 vfat usbhost"
# SERIAL_CONSOLES_CHECK = "${SERIAL_CONSOLES}"

IMAGE_BOOT_FILES += " \
                    boot.bin \
                    uEnv.txt \
                    "
```
